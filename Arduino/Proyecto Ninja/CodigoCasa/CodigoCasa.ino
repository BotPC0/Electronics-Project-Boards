//Panel oled
#include <SPI.h>
#include <Wire.h>
#include <Adafruit_GFX.h>
#include <Adafruit_SSD1306.h>


#define OLED_RESET 4
Adafruit_SSD1306 display(OLED_RESET);
#define NUMFLAKES 10
#define XPOS 0
#define YPOS 1
#define DELTAY 2

#define cameo18_GLCD_HEIGHT 64
#define cameo18_GLCD_WITDH 128


//VARIABLES GLOBALES
int conexionesMotor[] = {53, 52, 51, 50};
//int ldr = A15;
int zumbador = 46; //7.6, 5 es pasillo, 36,37,38 son el salón, 13,12,11 dormitorio, 10,9, 8 es cocina
//int leds[18] = {13,12,11,10,9,8,7,6,4,5,3,2,36,37,38,39,40,41};
int leds[18] =   {39, 40, 41, 44, 3, 2, 10, 9, 8, 36, 37, 38, 7, 6, 5, 13, 12, 11};

int ultrasonidos[] = {};
int Trigger[6] = {22, 32, 30, 26, 28, 24};
int Echo[6] = {23, 33, 31, 27, 29, 25};
int localizacion[6] = {0, 0, 0, 0, 0, 0};
int contador[6];
byte EstadoSensorDistancia[6];
int DistanciasDeEncendido[6] = {20, 10, 12, 15, 10, 15};
String valor;
byte estado = 0;


//definicion de pins para motor
const int motorPin1 = 53;    // 28BYJ48 In1
const int motorPin2 = 52;    // 28BYJ48 In2
const int motorPin3 = 51;   // 28BYJ48 In3
const int motorPin4 = 50;   // 28BYJ48 In4

//definicion variables
int motorSpeed = 3600;   //variable para fijar la velocidad
int stepCounter = 0;     // contador para los pasos
int stepsPerRev = 1000;  // pasos para una vuelta completa

//tablas con la secuencia de encendido (descomentar la que necesiteis)
//secuencia 1-fase
//const int numSteps = 4;
//const int stepsLookup[4] = { B1000, B0100, B0010, B0001 };

//secuencia 2-fases
//const int numSteps = 4;
//const int stepsLookup[4] = { B1100, B0110, B0011, B1001 };

//secuencia media fase
const int numSteps = 8;
const int stepsLookup[8] = { B1000, B1100, B0100, B0110, B0010, B0011, B0001, B1001 };



static const unsigned char PROGMEM cameo18_glcd_bmp[] =
{ 0x00, 0x00, 0x00, 0x00, 0x00, 0x00, 0x00, 0x00, 0x00, 0x00, 0x00, 0x00, 0x00, 0x00, 0x00, 0x00,
  0x00, 0x00, 0x00, 0x00, 0x00, 0x00, 0x00, 0x00, 0x00, 0x00, 0x00, 0x00, 0x00, 0x00, 0x00, 0x00,
  0x00, 0x00, 0x00, 0x00, 0x00, 0x00, 0x00, 0x00, 0x00, 0x00, 0x00, 0x00, 0x00, 0x00, 0x00, 0x00,
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  0x00, 0x00, 0x00, 0x00, 0x00, 0x00, 0x00, 0x00, 0x00, 0x00, 0x00, 0x00, 0x00, 0x00, 0x00, 0x00
};


void setup() {

  int variableencendido = 0;

  Serial.begin(9600);

  display.begin(SSD1306_SWITCHCAPVCC, 0x3C);  // initialize en el canal con la dirección 0x3D (para el 128x64)
  display.display();
  delay(20);

  //Motores
  //declarar pines como salida
  pinMode(motorPin1, OUTPUT);
  pinMode(motorPin2, OUTPUT);
  pinMode(motorPin3, OUTPUT);
  pinMode(motorPin4, OUTPUT);

  // LEDs
  for (int i = 13; i < 2; i--) {
    pinMode(i, OUTPUT);
  }
  for (int i = 36; i < 41; i++) {
    pinMode(i, OUTPUT);
  }
  //Trig[6] = {22, 32, 30, 26, 28, 24};
  //Echo[6] = {23, 33, 31, 27, 29, 25};
  //TriggerPin
  for (int i = 22; i < 33; i = i + 2) {
    pinMode(i, OUTPUT);
  }
  //EchoPin
  for (int i = 23; i < 34; i = i + 2) {
    pinMode(i, INPUT);
  }
  //Ldr
  //pinMode(A15);
}

void loop() {
  // put your main code here, to run repeatedly:
  valor = Serial.readString();
  //Conversor del string en Char.
  int valor_len = valor.length() + 1;
  char val[valor_len];
  valor.toCharArray(val, valor_len);
  int pos = atoi(&val[2]);
  Serial.print("String: ");
  Serial.println(valor);
  Serial.print("Char: ");
  Serial.println(val);
  Serial.print("int: ");
  Serial.println(pos);

  //ldr();
  dondeEstoy(Trigger, Echo);
  encenderLeds (localizacion);

  Rgb(val[0], val[1], pos);

  if (val[0] == 'M') {
    for (int i = 0; i < 100; i++) {

    }
  }
  if (val[0] == 'm') {
    for (int i = 0; i < 100; i++) {

    }
  }

  if (val[0] == 'T') {
    EnviarTexto(valor);
  }

  if (val[0] == 'L') { //Zumbador

    fzumbador();

  }


}

//Motor paso a paso
void clockwise()
{
  stepCounter++;
  if (stepCounter >= numSteps) stepCounter = 0;
  setOutput(stepCounter);
}



void anticlockwise()
{
  stepCounter--;
  if (stepCounter < 0) stepCounter = numSteps - 1;
  setOutput(stepCounter);
}

void setOutput(int step)
{
  digitalWrite(motorPin1, bitRead(stepsLookup[step], 0));
  digitalWrite(motorPin2, bitRead(stepsLookup[step], 1));
  digitalWrite(motorPin3, bitRead(stepsLookup[step], 2));
  digitalWrite(motorPin4, bitRead(stepsLookup[step], 3));
}

//ULTRASONIDOS
int distancia(int TriggerPin, int EchoPin) {
  double tiempo, distanciaCm;
  double relacion = 340.00 / 10000.00;

  digitalWrite(TriggerPin, LOW);
  delayMicroseconds(4);
  digitalWrite(TriggerPin, HIGH);
  delayMicroseconds(10);
  digitalWrite(TriggerPin, LOW);

  tiempo = pulseIn(EchoPin, HIGH);

  distanciaCm = tiempo * relacion / 2;


  return distanciaCm;
}


void dondeEstoy1 (int Trig[], int Echo[]) {
  //Dormitorio 22,23,
  int dDormitorio = 20;

  //Trig[6] = {22, 32, 30, 26, 28, 24};
  //Echo[6] = {23, 33, 31, 27, 29, 25};
  //Baño 32,33
  int dBano = 10;
  //Cocina 30,31
  int dCocina = 12;
  //Salon 26,27
  int dSalon = 15;
  //Pasillo, 28,29
  int dPasillo = 10;
  //Garaje 24,25
  int dGaraje = 15;

  if (((distancia(Trig[0], Echo[0])) < dDormitorio) && (localizacion[0] == 1)) {
    localizacion[0] = 0;
  }


  if (((distancia(Trig[1], Echo[1])) < dBano) && (localizacion[1] == 1)) {
    localizacion[1] = 0;
  }


  if (((distancia(Trig[2], Echo[2])) < dCocina) && (localizacion[2] == 0)) {
    localizacion[2] = 1;
    delay(500);

  }



  if (((distancia(Trig[2], Echo[2])) < dCocina) && (localizacion[2] == 1)) {
    localizacion[2] = 0;
  }



  if ((distancia(Trig[3], Echo[3])) < dSalon) {
    localizacion[3] = 1;
  }

  if ((distancia(Trig[4], Echo[4])) < dPasillo) {
    localizacion[4] = 1;
  }

  if ((distancia(Trig[5], Echo[5])) < dGaraje) {
    localizacion[5] = 1;
  }
  Serial.println(dDormitorio);
  Serial.println(dBano);
  Serial.println(dCocina);
  Serial.println(dSalon);
  Serial.println(dPasillo);
  Serial.println(dGaraje);
  Serial.println(localizacion[1]);
}

void dondeEstoy (int Trig[], int Echo[]) {

  //Trig[6] = {22, 32, 30, 26, 28, 24};
  //Echo[6] = {23, 33, 31, 27, 29, 25};

  for (int i = 0; i <= 5; i++) {

    if ((distancia(Trig[i], Echo[i])) < DistanciasDeEncendido[i]) {

      if (EstadoSensorDistancia[i] == 0) {

        EstadoSensorDistancia[i] = 1;
        contador[i] = contador[i] + 1;

        if ( contador[i] % 2 == 0) {
          localizacion[i] = 0;
        }

        else {
          localizacion[i] = 1;
        }
      }
    }
    else {
      EstadoSensorDistancia[i] = 0;
    }
  }


}

void encenderLeds (int lugar[6]) {
  for (int i = 0; i < 6; i++) {
    int ldr = analogRead(A15);
    // Serial.println(ldr);

    if ((lugar[i] == 1) && (ldr < 10)) {
      Serial.print("lugar: ");
      Serial.println(i);
      digitalWrite(leds[i * 3], HIGH);
      digitalWrite(leds[i * 3 + 1], HIGH);
      digitalWrite(leds[i * 3 + 2], HIGH);

      Serial.println("encender");
    }

    if ((lugar[i] == 0)) {
      Serial.print("lugar: ");
      Serial.println(i);
      digitalWrite(leds[i * 3], LOW);
      digitalWrite(leds[i * 3 + 1], LOW);
      digitalWrite(leds[i * 3 + 2], LOW);

      Serial.println("apagar");
    }

    if ((lugar[5] == 1) && (estado == 0)) {
      estado = 1;
      for (int i = 0; i < stepsPerRev * 2; i++)
      {
        clockwise();
        delayMicroseconds(motorSpeed);
      }
      delay(3000);
      for (int i = 0; i < stepsPerRev * 2; i++)
      {
        anticlockwise();
        delayMicroseconds(motorSpeed);
      }
      delay(1000);

    }

    if (lugar[3] == 1) {
      display.setTextSize(3);
      display.setTextColor(WHITE);
      display.setCursor(0, 0);
      display.println("Bienvenido");

      //display.drawBitmap(0, 0,  cameo18_glcd_bmp, 128, 64, 1);
      display.display();

    }
    else {
      display.clearDisplay();
       display.setTextSize(3);
      display.setTextColor(WHITE);
      display.setCursor(0, 0);
      display.println(" ");

      //display.drawBitmap(0, 0,  cameo18_glcd_bmp, 128, 64, 1);
      display.display();
    }


  }

}

void EnviarTexto (String valor) {

  display.setTextSize(2);
  display.setTextColor(WHITE);
  display.println(valor);
  display.display();
  delay(2000);
  display.clearDisplay();

}

void Rgb(char hab, char val, int pos) {
  int lugar;
  //dormitorio
  if (hab == 'D') {
    lugar = 1;
  }
  if (hab == 'C') {
    lugar = 2;
  }
  if (hab == 'D') {
    lugar = 3;
  }
  if (hab == 'G') {
    lugar = 4;
  }
  if (hab == 'P') {
    lugar = 5;
  }
  if (hab == 'S') {
    lugar = 6;
  }
  if ( val == 'R') {
    analogWrite(lugar * 3 - 2, pos);
    Serial.println("Enciendo Rojo");
  }
  if ( val == 'A') {
    analogWrite(lugar * 3 - 1, pos);
    Serial.println("Enciendo Azul");
  }
  if ( val == 'V') {
    analogWrite(lugar * 3, pos);
    Serial.println("Enciendo Verde");
  }
}

void fzumbador() {
  int random1;

  analogWrite(zumbador, 170);
  int randomdelay = random(100);
  delay(randomdelay);
  for (int i = 0; i <= 2; i++) {
    random1 = random(0, 2);
    digitalWrite(leds[i], random1);
  }
  delay(randomdelay);
  for (int i = 0; i <= 2; i++) {
    int random2 = random(255);
    analogWrite(leds[i + 3], random2);
  }
  delay(randomdelay);
  for (int i = 0; i <= 2; i++) {
    int random2 = random(255);
    analogWrite(leds[i + 6], random2);
  }
  delay(randomdelay);
  analogWrite(zumbador, 200);
  for (int i = 0; i <= 2; i++) {
    random1 = random(0, 2);
    digitalWrite(leds[i + 9], random1);
  }
  delay(randomdelay);
  for (int i = 0; i <= 2; i++) {
    int random2 = random(255);
    analogWrite(leds[i + 12], random2);
  }
  analogWrite(zumbador, 100);
  delay(randomdelay);
  for (int i = 0; i <= 2; i++) {
    int random2 = random(255);
    analogWrite(leds[i + 15], random2);
  }

}
